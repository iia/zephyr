## soc/nxp/kinetis/k32lx/Kconfig.defconfig
```kconfig
# Copyright (c) 2025 Ishraq Ibne Ashraf <ishraq.i.ashraf@gmail.com>
#
# SPDX-License-Identifier: Apache-2.0

if SOC_SERIES_K32LX

config NUM_IRQS
	default 32

config SYS_CLOCK_HW_CYCLES_PER_SEC
	default 48000000

endif # SOC_SERIES_K32LX
```
